## conf/layer.conf
```bitbake
BBPATH .= ":${LAYERDIR}"
NEREID_LAYER_ROOT := "${LAYERDIR}"
BBFILES += "${LAYERDIR}/recipes-*/*/*.bb ${LAYERDIR}/recipes-*/*/*.bbappend"
BBFILE_COLLECTIONS += "nereid"
BBFILE_PATTERN_nereid = "^${LAYERDIR}/"
BBFILE_PRIORITY_nereid = "20"
LAYERSERIES_COMPAT_nereid = "whinlatter"
LAYERDEPENDS_nereid = "core asteroid-layer hoki-ex"

# Keep the demo available without building or installing it in everyday images.
HOKI_WASM_DEMO ?= "0"

# Personal audiobook codec policy.
LICENSE_FLAGS_ACCEPTED:append:pn-faad2:hoki = " commercial_faad2"
```
